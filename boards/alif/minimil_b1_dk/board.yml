## boards/alif/minimil_b1_dk/board.yml
```yaml
board:
  name: minimil_b1_dk
  full_name: minimil b1 DK
  vendor: minimil
  socs:
  - name: ab1c1f4m51820hh0
  - name: ab1c1f4m51820ph0
  - name: ab1c1f1m41820hh0
  - name: ab1c1f1m41820ph0
```

## boards/minimil/minimil_b1_dk/board.yml
```yaml
board:
  name: minimil_b1_dk
  full_name: Minimil b1 DK
  vendor: minimil
  socs:
  - name: ab1c1f4m51820hh0
  - name: ab1c1f4m51820ph0
```

## boards/tera/term/Kconfig.term
```kconfig
# Copyright (c) 2025 Alif Semiconductor
#
# SPDX-License-Identifier: Apache-2.0

if BOARD_TERM

config BOARD_TERM
	select SOC_AB1C1F4M51820HH0_RTSS_HE 

config UART_DMA_ENABLE
	bool

endif
```

## boards/tera/term/board.yml
```yaml
board:
  name: term
  full_name: Tera Term Board
  vendor: tera
  socs:
  - name: ab1c1f4m51820hh0
  - name: ab1c1f4m51820ph0
```

## west.yml
```yaml
manifest:
  version: "0.13"

  remotes:
    - name: alif
      url-base: https://github.com/alifsemi

  projects:
    - name: alif
      url: https://github.com/alifsemi/sdk-alif.git
      revision: 0bb7d893537235fd7eb3dcb03ab8a923b1052884
      path: alif
      import: true

  self:
    path: minimil
# west build -p always -b alif_b1_dk/ab1c1f4m51820hh0/rtss_he samples/hello_world
# west build -b minimil_b1/rtss_he samples/hello_world
# west build -p always -b minimil_b1/rtss_he minimil/samples/hello_world
```
